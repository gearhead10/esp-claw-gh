## application/edge_agent/main/Kconfig.projbuild
```kconfig
menu "App Config"

menu "Default Wi-Fi Settings"

    config APP_WIFI_SSID
        string "Default Wi-Fi SSID"
        default ""
        help
            Default Wi-Fi SSID used to populate app settings.

    config APP_WIFI_PASSWORD
        string "Default Wi-Fi password"
        default ""
        help
            Default Wi-Fi password used to populate app settings.

    config APP_WIFI_AP_SSID_PREFIX
        string "Provisioning AP SSID prefix"
        default "esp-claw"
        help
            Prefix used to build the unique provisioning AP SSID. The full
            SSID is "<prefix>-<MAC[3..5]>" (e.g. esp-claw-84AEE5).

    config APP_WIFI_AP_CHANNEL
        int "Provisioning AP channel"
        range 1 13
        default 1
        help
            Channel used by the provisioning SoftAP.

    config APP_WIFI_AP_MAX_CONN
        int "Provisioning AP max connections"
        range 1 10
        default 4
        help
            Maximum number of concurrent stations on the provisioning AP.

    config APP_WIFI_MAX_RETRY
        int "STA max retries before AP fallback"
        range 1 20
        default 5
        help
            After this many consecutive STA connection failures the device
            falls back to pure AP mode and waits for the user to provision
            new credentials.

    config APP_WIFI_AP_AUTO_CLOSE
        bool "Close provisioning AP after STA connects"
        default y
        help
            When enabled, the SoftAP used for provisioning is shut down
            shortly after the device successfully joins the configured
            STA network. This reduces the attack surface of the always-on
            captive portal. The AP is reopened automatically if STA
            credentials become invalid (after APP_WIFI_MAX_RETRY failures).

    config APP_WIFI_AP_AUTO_CLOSE_DELAY_MS
        int "Grace period before closing the AP (ms)"
        depends on APP_WIFI_AP_AUTO_CLOSE
        range 0 60000
        default 3000
        help
            Time to keep the SoftAP up after STA gets an IP, so any client
            still on the captive portal can receive its last response
            before the AP goes away.

endmenu

menu "mDNS Settings"

    config APP_MDNS_ENABLE
        bool "Enable mDNS responder"
        default y
        help
            Advertise the device on the local network via mDNS so it can
            be reached at <hostname>.local without knowing its IP.

    config APP_MDNS_HOSTNAME
        string "mDNS hostname"
        depends on APP_MDNS_ENABLE
        default "esp-claw"
        help
            Hostname used by the mDNS responder. The device becomes
            reachable at "<hostname>.local" on the same network.

    config APP_MDNS_INSTANCE_NAME
        string "mDNS instance name"
        depends on APP_MDNS_ENABLE
        default "ESP-Claw Edge Agent"
        help
            Friendly instance name advertised alongside the HTTP service.

endmenu

menu "Default Web Search Settings"

    config APP_SEARCH_TAVILY_KEY
        string "Default Tavily API key"
        default ""
        help
            Compile-time default for the Tavily search API key. Used to
            populate app settings on first boot if NVS is empty. Leave
            blank to require runtime configuration via the web UI.

    config APP_SEARCH_BRAVE_KEY
        string "Default Brave Search API key"
        default ""
        help
            Compile-time default for the Brave Search API key. Used to
            populate app settings on first boot if NVS is empty. Leave
            blank to require runtime configuration via the web UI.

endmenu

menu "Default Search Settings"

    config APP_SEARCH_HTTP_ALLOWLIST
        string "Default HTTP Request allowlist"
        default "*"
        help
            Default value used to populate app setting `search_http_allowlist`.
            Use `*` to allow all hosts, or a comma-separated list of domains/IPs.

            e.g. "api.example.com,*.example.org,203.0.113.10"

endmenu

endmenu
```

## components/claw_capabilities/cap_ble_scan/Kconfig
```kconfig
menu "Claw BLE Scan Capability"

config CLAW_CAP_BLE_SCAN_MAX_RESULTS
    int "Max devices retained per scan"
    default 32
    range 8 128
    help
        Upper bound on the number of distinct BLE devices retained in one
        scan window. Beyond this limit further advertising packets are
        dropped and the result JSON sets truncated=true. Higher values
        cost ~96 bytes of heap per entry.

config CLAW_CAP_BLE_SCAN_DEFAULT_DURATION_MS
    int "Default scan duration (ms)"
    default 5000
    range 500 60000
    help
        Default window length used when the LLM does not specify
        duration_ms in the call input. Clamped to [500, 60000] at
        runtime regardless of this setting.

config CLAW_CAP_BLE_SCAN_PASSIVE
    bool "Use passive scanning by default"
    default y
    help
        Passive scan only listens; active scan also issues SCAN_REQ to
        peers that advertise scannable PDUs (gets richer name / mfg data
        but is detectable and a bit more power-hungry). Per-call override
        is exposed via the "active" input field.

endmenu
```

## components/claw_capabilities/cap_diagnose/Kconfig
```kconfig
menu "Claw Diagnose Capability"

config CLAW_CAP_DIAGNOSE_RING_CAPACITY
    int "In-memory log ring capacity (entries)"
    default 64
    range 16 256
    help
        How many recent log lines are retained in heap for cap_diagnose
        to surface to the LLM. Older entries are overwritten when full.

config CLAW_CAP_DIAGNOSE_MAX_LINE_LEN
    int "Per-log-line max length (bytes)"
    default 240
    range 96 512
    help
        Each captured log line is truncated to this length. Lower values
        reduce heap pressure at the cost of losing tail context.

endmenu
```

## components/claw_modules/claw_core/Kconfig
```kconfig
menu "ESP-Claw Core"

choice CLAW_CORE_STAGE_VERBOSITY
    prompt "Agent stage notification verbosity"
    default CLAW_CORE_STAGE_VERBOSITY_SIMPLE
    help
        Controls how much detail is forwarded to IM channels during agent execution.

config CLAW_CORE_STAGE_VERBOSITY_SIMPLE
    bool "Simple"
    help
        Send only essential updates: tool names being invoked.

config CLAW_CORE_STAGE_VERBOSITY_VERBOSE
    bool "Verbose"
    help
        Include tool arguments preview and iteration round in addition to tool
        names. Useful for debugging and power users.

endchoice

config CLAW_CORE_STRIP_THINK_TAGS
    bool "Strip <think>...</think> blocks from user-facing responses"
    default y
    help
        When the LLM emits inline reasoning tags (DeepSeek R1, Qwen3 reasoning,
        local backends without structured separation), strip them from the final
        text before delivering to Web IM, Telegram, QQ, MCP server, etc.
        Reasoning that comes through the structured 'reasoning_content' field
        is unaffected by this option.

endmenu
```
